## config/west.yml
```yaml
manifest:
  remotes:
    - name: zmkfirmware
      url-base: https://github.com/zmkfirmware
     # Adding additional pixelart for the nice_view shield
    - name: PiXeL16                         #new entry
      url-base: https://github.com/PiXeL16 #new entry
      # Additional modules containing boards/shields/custom code can be listed here as well.
      # See:
      # - https://zmk.dev/docs/features/modules
      # - https://docs.zephyrproject.org/3.5.0/develop/west/manifest.html#projects
  projects:
    - name: eyelash_corne
      url: https://github.com/a741725193/zmk-new_corne
      revision: main
    - name: zmk
      remote: zmkfirmware
      revision: main
      import: app/west.yml
    - name: zmk-landscape-slideshow          #new entry
      remote: PiXeL16                     #new entry
      revision: main                      #new entry
  self:
    path: config
```
